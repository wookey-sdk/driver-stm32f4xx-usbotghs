## Kconfig
```kconfig
config USR_DRV_USBOTGHS
  bool  "userspace USB OTG HS driver library"
  default y
  ---help---
  Support for STM32 USB OTG HS.

if USR_DRV_USBOTGHS

menu "USB-HS related features"

choice
   prompt "USBOTG HS driver mode"
   default USR_DRV_USBOTGHS_MODE_DEVICE
   config USR_DRV_USBOTGHS_MODE_DEVICE
      bool "USB OTG HS driver in device mode"
      ---help---
      the driver is configured to work in device mode. EPs directions are
      inverted in comparison with the host (and USB standard) mode, i.e.
      IN EP send data, OUT EP receive data.
   config USR_DRV_USBOTGHS_MODE_HOST
      bool "USB OTG HS driver in host mode (WiP)"
      ---help---
      the driver is configured to work in host mode. EPs directions are
      configured in USB standard mode, i.e. IN EP receive data, OUT EP send data.
endchoice


config USR_DRV_USBOTGHS_DEBUG
  bool "Activate debuggging for USB OTG HS driver"
  default n
  ---help---
  Activate various debugging for usb OTG High speed.
  This option is efficient only if KERNEL_SERIAL is activated.


config USR_DEV_USBOTGHS_DMA
  bool "Enable DMA-based transmissions"
  default n
  ---help---
  Activate DMA-based memory copy between device and RAM FIFOs

config USR_DEV_USBOTGHS_TRIGER_XMIT_ON_HALF
  bool "Trigger application when TxFIFO is half empty"
  default n
  ---help---
  Inform the driver that the TxFIFO is half empty, this permit to
  paralelize data copy to FIFO and USB transmition, using two FIFO
  stage in the same time.
  This reduce the amount of TxFIFO that can be used in one time.

endmenu

endif
```
